## boards/shields/tweakbit/Kconfig.defconfig
```kconfig
if SHIELD_mmkey_min_R

config ZMK_KEYBOARD_NAME
    default "mmkey_min"

config ZMK_BLE
    bool
    default y

config ZMK_SPLIT_ROLE_CENTRAL
    bool
    default y
endif

if SHIELD_mmkey_min_R || SHIELD_mmkey_min_L
config NFCT_PINS_AS_GPIOS
    bool
    default y

config ZMK_SPLIT
    bool
    default y

config INPUT
    bool
    default y

config ZMK_POINTING
    bool
    default n

config SPI
    bool
    default n

config PMW3610
    bool
    default n

config PMW3610_SWAP_XY
    bool
    default n
endif
```

## boards/shields/tweakbit/Kconfig.shield
```kconfig
config SHIELD_mmkey_min_R
    def_bool $(shields_list_contains,mmkey_min_r)

config SHIELD_mmkey_min_L
    def_bool $(shields_list_contains,mmkey_min_l)
```

## config/west.yml
```yaml
manifest:
  remotes:
    - name: zmkfirmware
      url-base: https://github.com/zmkfirmware
    - name: my-repo
      url-base: https://github.com/my-github
    ##- name: badjeff    # <-- PMW3610
    ##  url-base: https://github.com/badjeff
    ##- name: caksoylar  # <-- RGB LED
    ##  url-base: https://github.com/caksoylar  
  projects:
    - name: zmk
      remote: zmkfirmware
      revision: v0.2.1
      import: app/west.yml
    #- name: zmk-pmw3610-driver
    #  remote: badjeff
    #  revision: v0.2.1
    #- name: zmk-rgbled-widget
    #  remote: caksoylar
    #  revision: main
  self:
    path: config
```
